## board/microsys/crxs32g/Kconfig
```kconfig
# Copyright (C) 2023 MicroSys Electronics GmbH

menu "MicroSys Carrier"

choice
    prompt "Carrier Board CRX for S32G"
    default MICROSYS_CRXS32GR2

config MICROSYS_CRX_NONE
	bool "CRX carrier-less configuration"

config MICROSYS_CRXS32GR2
	bool "CRX-S32G Carrier Board Rev. 2"
	imply NVME
	imply RGMII
	imply PHY_MARVELL
	select ADC

config MICROSYS_CRXS32GR3
	bool "CRX-S32G Carrier Board Rev. 3"
	imply NVME
	imply RGMII
	imply PHY_MARVELL
	select ADC

endchoice

endmenu
```

## board/microsys/mpxs32g274ar5/Kconfig
```kconfig
# Copyright (C) 2023 MicroSys Electronics GmbH

config SYS_VENDOR
	string
	default "microsys"

config MICROSYS_MPXS32G274AR5
	bool "Support mpxs32g274a rev. 5"
	imply CMD_PMIC
	imply DM_PMIC
	imply DM_PMIC_VR5510
	imply NXP_S32CC_BOARD_COMMON
	imply CMD_EEPROM
	imply I2C_EEPROM
	imply ADC
	imply PHY
	imply PHYLIB
	imply PHY_GIGE
	imply SAF1508BET_USB_PHY
	imply DM_USB
	imply USB_EHCI_HCD
	imply USB_ULPI
	select USB
	select USB_EHCI_MX6
	select NXP_S32G2
	select SARADC_S32CC
	select SPI_FLASH_STMICRO
	help
		Platforms with MicroSys' MPXS32G274AR5 module
```

## board/microsys/s32g274ar3sbc3/Kconfig
```kconfig
# Copyright (C) 2023 MicroSys Electronics GmbH

if TARGET_S32G274AR3SBC3

config SYS_CONFIG_NAME
    string
    default "s32g274ar3sbc3"

config SYS_BOARD
    string
    default "s32g274ar3sbc3"

endif

config S32CC_HWCONFIG
    string "S32CC HWConfig definition"
    default "serdes0:mode=pcie&xpcs0,clock=ext,fmhz=100;xpcs0_1:speed=1G;pcie0:mode=rc;serdes1:mode=pcie&xpcs0,clock=ext,fmhz=100;xpcs1_1:speed=1G;pcie1:mode=rc"
    default ""
    help
      The configuration for the PCIe controllers, stored in
      the variable 'hwconfig'
      It configures the mode (RC, EP, SGMII) or the clock type
      (internal or external)
```

## board/tttech/s32g274atttechn4/Kconfig
```kconfig
if TARGET_S32G274ATTTECHN4

config SYS_CONFIG_NAME
	default "s32g274atttechn4"

config SYS_BOARD
	default "s32g274atttechn4"

config SYS_VENDOR
	default "tttech"

config NR_DRAM_BANKS
	default 2

config SYS_DATA_BASE
	default 0xdfa00000

config SYS_TEXT_BASE
	default 0xdfaa0000

endif
```

## configs/s32g274atttechn4_defconfig
```kconfig
CONFIG_ARM=y
CONFIG_ARCH_S32G2=y
CONFIG_TARGET_S32G274ATTTECHN4=y
# CONFIG_DISPLAY_CPUINFO is not set
CONFIG_FIT=y
CONFIG_SD_BOOT=y
CONFIG_PHY_GIGE=y
CONFIG_MII=y
CONFIG_SJA1105=y
CONFIG_OF_CONTROL=y
CONFIG_DEFAULT_DEVICE_TREE="s32g274atttechn4"
CONFIG_CMD_PMIC=y
CONFIG_BOOTM_EFI=y
CONFIG_CMD_TIMER=y
CONFIG_DM_MDIO=y
CONFIG_DM_PMIC_VR5510=y
CONFIG_DM_PMIC=y
CONFIG_PMIC_CHILDREN=y
CONFIG_NXP_HSE_SUPPORT=y
CONFIG_NXP_HSE_FW_FILE="s32cc_hse_fw.bin"
CONFIG_STACK_SIZE=0x4000000
CONFIG_OF_BOARD_SETUP=y
CONFIG_NXP_S32GRDB_BOARD=y
CONFIG_CMD_SPI=y
CONFIG_PHY_AQUANTIA=n
CONFIG_PHY_MARVELL=y
CONFIG_PHYLIB_10G=y
CONFIG_DM_DSA=y

CONFIG_PCI=n
CONFIG_PCI_S32CC=n
CONFIG_PCI_ENDPOINT=n
CONFIG_E1000=n
CONFIG_CUSTOM_SYS_TEXT_BASE=y
CONFIG_SYS_TEXT_BASE=0xdfaa0000
CONFIG_CUSTOM_SYS_DATA_BASE=y
CONFIG_SYS_DATA_BASE=0xdfa00000
CONFIG_S32CC_MAX_DTB_SIZE=0x8000
CONFIG_SERIAL=y
CONFIG_REQUIRE_SERIAL_CONSOLE=y
CONFIG_SERIAL_PRESENT=y
#CONFIG_OF_BOARD_SETUP=y
#CONFIG_OF_SYSTEM_SETUP=y
CONFIG_NXP_S32GRDB_BOARD=y
CONFIG_NXP_S32CC_BOARD_COMMON=y
CONFIG_ADC=y
CONFIG_SARADC_S32CC=y
#CONFIG_SPI_FLASH_MACRONIX=y
#CONFIG_SPI_FLASH_STMICRO=y
CONFIG_SPI_FLASH_MACRONIX=y
CONFIG_SPI_FLASH_MX25UW51245G=y
#CONFIG_NXP_S32GRDB_BOARD=y
CONFIG_SYS_MEM_SIZE=0x00800000
#CONFIG_S32CC_HWCONFIG="serdes0:mode=xpcs0&xpcs1,clock=ext,fmhz=125;serdes1:mode=xpcs0&xpcs1,clock=ext,fmhz=125;xpcs0_0:speed=100M;xpcs0_1:speed=100M;xpcs1_0:speed=100M;xpcs1_1:speed=100M"
CONFIG_S32CC_HWCONFIG="serdes0:mode=xpcs0,clock=int,fmhz=100;serdes1:mode=pcie,clock=ext,fmhz=100;pcie1:mode=rc;xpcs0_0:speed=1G;xpcs0_1:speed=1G;"
CONFIG_PINCTRL_SCMI=n
CONFIG_ENV_OFFSET=0x2000
#CONFIG_SYS_MALLOC_F_LEN=0x2000
#CONFIG_SYS_EEPROM_PAGE_WRITE_DELAY_MS=5
#CONFIG_SYS_EEPROM_SIZE=256
#CONFIG_S32CC_SCMI_GPIO_FIXUP=y
#CONFIG_CSF_SIZE=0x2060
CONFIG_IMX_DCD_ADDR=0x00910000
```
